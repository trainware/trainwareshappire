/*=================================================== RTC ===========*/

// Aliasing Library Menjadi DS1307_RTC
RTC_DS1307 DS1307_RTC;

// Inisialisasi Variable Hari 1 Minggu 
String Week_days[8] = {"Minggu", "Senin", "Selasa", "Rabu", "Kamis", "Jumat", "Sabtu"};

void init_rtc(){
  // Inisialisasi Start DS1307
  if (!DS1307_RTC.begin()) {
    Serial.println("Couldn't find RTC");
    // while(1);
  }
}

void set_ds1307_TimeCompile(){
  // Inisialisasi Start DS1307
  if (!DS1307_RTC.begin()) {
    Serial.println("Couldn't find RTC");
    while(1);
  }

  // Mengatur waktu pada RTC berdasarkan waktu terakhir Compile Time
  DS1307_RTC.adjust(DateTime(F(__DATE__), F(__TIME__)));
}

DateTime now;

void rtc_to_lcd(){
  // Menyimpan nilai waktu sekarang ke dalam Variabel "DateTime now"
  now = DS1307_RTC.now();

  lcd_putsxy(6,0, String(now.day()) + "/");
  lcd_putsxy(9,0, String(now.month()) + "/");
  lcd_putsxy(12,0, String(now.year()));

  lcd_putsxy(0,1, String(now.hour()) + ":");
  lcd_putsxy(3,1, String(now.minute()) + ":");
  lcd_putsxy(6,1, String(now.second()));

  lcd_putsxy(9,1, Week_days[now.dayOfTheWeek()]);
}

/*=================================================== LCD ===========*/
int lcdColumns = 16;
int lcdRows = 2;
LiquidCrystal_I2C lcd(0x27, lcdColumns, lcdRows);  

void init_lcd(){
  // Inisialisasi LCD
  lcd.init();
  // Fungsi menyalakan backlight LCD
  lcd.backlight();
}

void lcd_putsxy(uint8_t x, uint8_t y, String str){
  lcd.setCursor(x,y);
  lcd.print(str);
}

void lcd_erase(char x,char y){
  lcd_putsxy(x,y," ");
}

/*=================================================== OLED ===========*/
Adafruit_SSD1306 oled(SCREEN_WIDTH, SCREEN_HEIGHT, &Wire, -1);

static const uint8_t image_HEX_array0[1024] = {
  0x00, 0x00, 0x00, 0x00, 0x00, 0x00, 0x00, 0x00, 0x00, 0x00, 0x00, 0x00, 0x00, 0x00, 0x00, 0x00, 
	0x00, 0x00, 0x00, 0x00, 0xff, 0xff, 0xff, 0xff, 0xff, 0xfc, 0x00, 0xff, 0x80, 0x00, 0x00, 0x00, 
	0x00, 0x00, 0x00, 0x00, 0xff, 0xff, 0xff, 0xff, 0xff, 0xfc, 0x01, 0xff, 0x00, 0x00, 0x00, 0x00, 
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	0x00, 0x00, 0x00, 0x00, 0x00, 0x00, 0x00, 0x00, 0x00, 0x00, 0x00, 0x00, 0x00, 0x00, 0x00, 0x00

};

static const uint8_t image_HEX_array1[1024] = {
  0xff, 0xff, 0xff, 0xff, 0xff, 0xff, 0xff, 0xff, 0xff, 0xff, 0xff, 0xff, 0xff, 0xff, 0xff, 0xff, 
	0xff, 0xff, 0xff, 0xff, 0xff, 0xff, 0xff, 0xff, 0xff, 0xff, 0xff, 0xc0, 0xff, 0xff, 0xff, 0xff, 
	0xff, 0xff, 0xff, 0xff, 0x80, 0x00, 0x00, 0x00, 0x00, 0x07, 0xff, 0x00, 0xff, 0xff, 0xff, 0xff, 
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	0xff, 0xff, 0xff, 0xff, 0xff, 0xff, 0xff, 0xff, 0xff, 0xff, 0xff, 0xff, 0xff, 0xff, 0xff, 0xff
};

static const uint8_t image_HEX_array2[1024] = {
  	0x00, 0x00, 0x00, 0x00, 0x00, 0x00, 0x00, 0x00, 0x00, 0x00, 0x00, 0x00, 0x00, 0x00, 0x00, 0x00, 
	0x00, 0x00, 0x00, 0x00, 0x00, 0x00, 0x00, 0x00, 0x00, 0x00, 0x00, 0x00, 0x00, 0x00, 0x00, 0x00, 
	0x00, 0x00, 0x00, 0x00, 0x00, 0x00, 0x00, 0x00, 0x00, 0x00, 0x00, 0x00, 0x00, 0x00, 0x00, 0x00, 
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	0x00, 0x00, 0x00, 0x00, 0x00, 0x00, 0x00, 0x00, 0x00, 0x00, 0x00, 0x00, 0x00, 0x00, 0x00, 0x00
};

void init_oled(){
  // Fungsi untuk Start OLED SSD1306, 
  // Jika gagal maka ada keterangan 
  // "SSD1306 Allocation failed"
  if(!oled.begin(SSD1306_SWITCHCAPVCC, 0x3C)) { // Address 0x3D for 128x64
    Serial.println(F("SSD1306 allocation failed"));
    for(;;);
  }
}

byte state_oled=0;

void oled_putimg(){
  unsigned long time_now=millis();

  if(state_oled==0){
    oled.clearDisplay(); // clear display buffer
    oled.drawBitmap(0, 0, image_HEX_array0, 128, 64, 1);
    oled.display();
  }
  else if(state_oled==1){
    oled.clearDisplay(); // clear display buffer
    oled.drawBitmap(0, 0, image_HEX_array1, 128, 64, 1);
    oled.display();
  }
  else if(state_oled==2){
    oled.clearDisplay(); // clear display buffer
    oled.drawBitmap(0, 0, image_HEX_array2, 128, 64, 1);
    oled.display();
  }
  if(time_now-time_last>=3000){
    state_oled++;
    if(state_oled>2){state_oled=0;}
    time_last=time_now;
  }
}

void oled_putsxy(uint8_t x, uint8_t y, String str){
  // fungsi posisi x y text
  oled.setCursor(x, y);
  // Fungsi menampilkan Text
  oled.println(str);
}